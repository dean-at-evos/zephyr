## prj.conf
```kconfig
#Turn on the Hawkbit
CONFIG_HAWKBIT=y
CONFIG_NVS=y
CONFIG_FLASH=y
CONFIG_FLASH_MAP=y
CONFIG_STREAM_FLASH=y
CONFIG_REBOOT=y
CONFIG_HWINFO=y
CONFIG_NET_TCP=y
CONFIG_NET_SOCKETS=y
CONFIG_IMG_MANAGER=y
CONFIG_NETWORKING=y
CONFIG_HTTP_CLIENT=y
CONFIG_DNS_RESOLVER=y
CONFIG_JSON_LIBRARY=y
CONFIG_BOOTLOADER_MCUBOOT=y

#For wifi..
CONFIG_EARLY_CONSOLE=y

CONFIG_TEST_RANDOM_GENERATOR=y

CONFIG_NET_TX_STACK_SIZE=2048
CONFIG_NET_RX_STACK_SIZE=2048

CONFIG_NET_PKT_RX_COUNT=10
CONFIG_NET_PKT_TX_COUNT=10
CONFIG_NET_BUF_RX_COUNT=20
CONFIG_NET_BUF_TX_COUNT=20
CONFIG_NET_MAX_CONTEXTS=10
CONFIG_NET_DHCPV4=y

CONFIG_NET_LOG=y
CONFIG_INIT_STACKS=y

CONFIG_NET_SHELL=y

CONFIG_NET_STATISTICS=y
CONFIG_NET_STATISTICS_PERIODIC_OUTPUT=n

CONFIG_WIFI=y
CONFIG_WIFI_LOG_LEVEL_ERR=y
CONFIG_NET_L2_WIFI_SHELL=y

#Main Stack Size
CONFIG_MAIN_STACK_SIZE=4096

#Minimal Heap mem pool size for the Hawkbit working
CONFIG_HEAP_MEM_POOL_SIZE=4096
CONFIG_SYSTEM_WORKQUEUE_STACK_SIZE=4096

CONFIG_NET_IPV4=y
CONFIG_NET_IPV6=n

#Enable DHCPv4 server
CONFIG_NET_DHCPV4=y
CONFIG_NET_MGMT=y
CONFIG_NET_MGMT_EVENT=y

#Enable DNS Resolver
CONFIG_DNS_RESOLVER=y
CONFIG_DNS_SERVER_IP_ADDRESSES=y
CONFIG_DNS_SERVER1="8.8.8.8"
CONFIG_DNS_SERVER2="192.168.1.1"

#Optional if you would like test on the your server
CONFIG_SHELL=y
CONFIG_HAWKBIT_SHELL=y
CONFIG_KERNEL_SHELL=y
CONFIG_SHELL_STACK_SIZE=4096

#Hawkbit polling mode
CONFIG_HAWKBIT_POLLING=y

#Config Hawkbit Server
CONFIG_HAWKBIT_SERVER="192.168.1.27"

#Debug helpers
CONFIG_LOG=y
CONFIG_HAWKBIT_LOG_LEVEL_DBG=y

#General Config
CONFIG_REQUIRES_FULL_LIBC=y
CONFIG_LOG_BUFFER_SIZE=4096

#Generate HEX output
CONFIG_BUILD_OUTPUT_HEX=y
```

## src/main.c
```c
/*
 * Copyright (c) 2020 Linumiz
 *
 * SPDX-License-Identifier: Apache-2.0
 */

#include <zephyr/kernel.h>
#include <zephyr/mgmt/hawkbit.h>
#include <zephyr/dfu/mcuboot.h>
#include <zephyr/sys/printk.h>
#include <zephyr/sys/reboot.h>
#include <zephyr/logging/log.h>

#include "dhcp.h"
#include "wifi.h"

#if defined(CONFIG_NET_SOCKETS_SOCKOPT_TLS)
#include <zephyr/net/tls_credentials.h>
#include "ca_certificate.h"
#endif

LOG_MODULE_REGISTER(main);

int main(void)
{
	int ret = -1;

	LOG_INF("Hawkbit sample app started");
	LOG_INF("Image build time: " __DATE__ " " __TIME__);

#if defined(CONFIG_NET_L2_WIFI_SHELL)
	LOG_INF("WiFi shell mode, try and connect");
	app_wifi_startup();
#else
	app_dhcpv4_startup();
#endif

#if defined(CONFIG_NET_SOCKETS_SOCKOPT_TLS)
	tls_credential_add(CA_CERTIFICATE_TAG, TLS_CREDENTIAL_CA_CERTIFICATE, ca_certificate,
			   sizeof(ca_certificate));
#endif

	ret = hawkbit_init();

	if (ret < 0) {
		LOG_ERR("Failed to init hawkbit");
	}

#if defined(CONFIG_HAWKBIT_POLLING)
	LOG_INF("Starting hawkbit polling mode");
	hawkbit_autohandler();
#endif

#if defined(CONFIG_HAWKBIT_MANUAL)
	LOG_INF("Starting hawkbit manual mode");

	switch (hawkbit_probe()) {
	case HAWKBIT_UNCONFIRMED_IMAGE:
		LOG_ERR("Image is unconfirmed");
		LOG_ERR("Rebooting to previous confirmed image");
		LOG_ERR("If this image is flashed using a hardware tool");
		LOG_ERR("Make sure that it is a confirmed image");
		k_sleep(K_SECONDS(1));
		sys_reboot(SYS_REBOOT_WARM);
		break;

	case HAWKBIT_NO_UPDATE:
		LOG_INF("No update found");
		break;

	case HAWKBIT_CANCEL_UPDATE:
		LOG_INF("Hawkbit update cancelled from server");
		break;

	case HAWKBIT_OK:
		LOG_INF("Image is already updated");
		break;

	case HAWKBIT_UPDATE_INSTALLED:
		LOG_INF("Update installed");
		break;

	case HAWKBIT_PROBE_IN_PROGRESS:
		LOG_INF("Hawkbit is already running");
		break;

	default:
		break;
	}

#endif
	return 0;
}
```

## src/wifi.c
```c
/*
 * Copyright (c) 2023 Evos
 *
 * SPDX-License-Identifier: Apache-2.0
 */

#include <zephyr/logging/log.h>

#include <zephyr/kernel.h>

#include <zephyr/net/wifi_mgmt.h>

static struct net_mgmt_event_callback mgmt_cb;

/* Semaphore to indicate a lease has been acquired */
static K_SEM_DEFINE(got_address, 0, 1);

LOG_MODULE_REGISTER(wifi);

static void handler(struct net_mgmt_event_callback *cb, uint32_t mgmt_event, struct net_if *iface)
{

	switch (mgmt_event) {
	case NET_EVENT_IPV4_DHCP_START:
		LOG_INF("DHCP Start... %u", mgmt_event);
		break;

	case NET_EVENT_IPV4_DHCP_BOUND:
		LOG_INF("DHCP Bound... %u", mgmt_event);
		char buf[NET_IPV4_ADDR_LEN];

		LOG_INF("Your address: %s",
			(net_addr_ntop(AF_INET, &iface->config.dhcpv4.requested_ip, buf,
				       sizeof(buf))));
		LOG_INF("Lease time: %u seconds", iface->config.dhcpv4.lease_time);
		LOG_INF("Subnet: %s", (net_addr_ntop(AF_INET, &iface->config.ip.ipv4->netmask, buf,
						     sizeof(buf))));
		LOG_INF("Router: %s",
			(net_addr_ntop(AF_INET, &iface->config.ip.ipv4->gw, buf, sizeof(buf))));
		k_sem_give(&got_address);
		break;

	default:
		LOG_DBG("IF Event %u", mgmt_event);
	}
}

/**
 * WiFi connect starts dhcp wait for a lease to be acquired.
 */
void app_wifi_startup(void)
{
	struct net_if *iface;

	net_mgmt_init_event_callback(&mgmt_cb, handler,
				     NET_EVENT_IPV4_DHCP_START | NET_EVENT_IPV4_DHCP_BOUND);
	net_mgmt_add_event_callback(&mgmt_cb);
	LOG_INF("WiFi startup waiting...");
	/* Wait for a lease */
	k_sem_take(&got_address, K_FOREVER);
	LOG_INF("WiFi startup finished.");
}
```

## src/wifi.h
```c
/*
 * Copyright (c) 2023 Evos
 *
 * SPDX-License-Identifier: Apache-2.0
 */

#ifndef __WIFI_H__
#define __WIFI_H__

void app_wifi_startup(void);

#endif
```
